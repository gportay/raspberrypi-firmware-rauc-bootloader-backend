## support/Config.in
```kconfig
comment "raspberrypi-firmware-rauc-bootloader-backend needs rpi-userland"
	depends on !BR2_PACKAGE_RPI_USERLAND

config BR2_PACKAGE_RASPBERRYPI_FIRMWARE_RAUC_BOOTLOADER_BACKEND
	bool "raspberrypi-firmware-rauc-bootloader-backend"
	depends on !BR2_STATIC_LIBS # dtc
	depends on BR2_PACKAGE_BUSYBOX_SHOW_OTHERS # bash
	depends on BR2_PACKAGE_RPI_USERLAND # runtime (vcmailbox)
	depends on BR2_USE_MMU # bash
	select BR2_PACKAGE_BASH # runtime
	select BR2_PACKAGE_DTC # dtc-programs
	select BR2_PACKAGE_DTC_PROGRAMS # runtime (fdtget)
	help
	  An implementation of a RAUC custom bootloader backend for the
	  Raspberry Pi firmware.

	  https://www.portay.io/raspberrypi-firmware-rauc-bootloader-backend/
```
